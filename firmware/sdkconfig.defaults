## firmware/sdkconfig.defaults
```kconfig
# Line ending configuration
CONFIG_LIBC_STDOUT_LINE_ENDING_CRLF=y
CONFIG_LIBC_STDIN_LINE_ENDING_CR=y

# Partition table - larger app partition for BLE
CONFIG_PARTITION_TABLE_CUSTOM=y
CONFIG_PARTITION_TABLE_CUSTOM_FILENAME="partitions.csv"
CONFIG_PARTITION_TABLE_FILENAME="partitions.csv"

# Use USB Serial/JTAG for console, freeing GPIO 20/21 for NFC
CONFIG_ESP_CONSOLE_UART_DEFAULT=n
CONFIG_ESP_CONSOLE_USB_SERIAL_JTAG=y
CONFIG_ESP_CONSOLE_SECONDARY_NONE=y

# Bluetooth configuration
CONFIG_BT_ENABLED=y
CONFIG_BT_BLUEDROID_ENABLED=y
CONFIG_BT_BLE_42_FEATURES_SUPPORTED=y
CONFIG_BT_GATTS_SEND_SERVICE_CHANGE_AUTO=y
CONFIG_BT_BLE_DYNAMIC_ENV_MEMORY=n
```
